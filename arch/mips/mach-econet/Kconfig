## arch/mips/mach-econet/Kconfig
```kconfig
menu "Airoha MIPS platforms"
	depends on ARCH_ECONET

choice
	prompt "Airoha MIPS SoC"

config TARGET_EN751221
	bool "Airoha EN751221 SoC"
	select SUPPORT_BIG_ENDIAN
	select SYSCON
	select MIPS_TUNE_34KC
	select PINCTRL_AIROHA_EN751221

config TARGET_EN751627
	bool "Airoha EN751627 SoC"
	select SUPPORT_BIG_ENDIAN
	select SYSCON
	select MIPS_TUNE_1004KC
	select MIPS_SKIP_CP0_COUNT_CLEAR
	help
	  EN7516/EN7527 shares most peripheral support with EN7528 but boots
	  big-endian. Early DDR/flash boot stages are built outside U-Boot.

config TARGET_EN7528
	bool "Airoha EN7528 SoC"
	select SUPPORT_LITTLE_ENDIAN
	select SYSCON
	select MIPS_TUNE_1004KC
	select MIPS_SKIP_CP0_COUNT_CLEAR
	select PINCTRL_AIROHA_EN7528

config TARGET_EN7580
	bool "Airoha EN7580 SoC"
	select SUPPORT_LITTLE_ENDIAN
	select SYSCON
	select MIPS_TUNE_1004KC
	select MIPS_SKIP_CP0_COUNT_CLEAR
	help
	  Select support for the little-endian MIPS32r2 EN7580 family.
	  U-Boot proper is entered after the external early-boot/DRAM stage.

endchoice

config SYS_VENDOR
	default "econet"

config SYS_SOC
	default "en751221" if TARGET_EN751221
	default "en7528" if TARGET_EN7528 || TARGET_EN751627
	default "en7580" if TARGET_EN7580

config SYS_BOARD
	default "en7512" if TARGET_EN751221
	default "en7528" if TARGET_EN7528 || TARGET_EN751627
	default "en7580" if TARGET_EN7580

config SYS_CONFIG_NAME
	default "en7512" if TARGET_EN751221
	default "en7528" if TARGET_EN7528 || TARGET_EN751627
	default "en7580" if TARGET_EN7580

config SYS_MALLOC_F_LEN
	default 0x2000

config SYS_DCACHE_SIZE
	default 32768

config SYS_DCACHE_LINE_SIZE
	default 32

config SYS_ICACHE_SIZE
	default 32768

config SYS_ICACHE_LINE_SIZE
	default 32

config TEXT_BASE
	default 0x81000000

config BUILD_TARGET
	default "u-boot.img"

endmenu
```

## arch/mips/mach-en75xx/Kconfig
```kconfig
menu "EcoNet/Airoha EN75xx platforms"
	depends on ARCH_EN75XX

config SYS_VENDOR
	default "econet"

config SYS_SOC
	default "en7512"

config SYS_BOARD
	default "en7512"

config SYS_CONFIG_NAME
	default "en7512"

config SYS_MALLOC_F_LEN
	default 0x2000

config SYS_DCACHE_SIZE
	default 32768

config SYS_DCACHE_LINE_SIZE
	default 32

config SYS_ICACHE_SIZE
	default 32768

config SYS_ICACHE_LINE_SIZE
	default 32

config TEXT_BASE
	default 0x81000000

config SPL_TEXT_BASE
	default 0x80010000

config SPL_SIZE_LIMIT
	default 0x30000

config TPL_TEXT_BASE
	default 0xbfc00000

config TPL_MAX_SIZE
	default 0x8000


config BUILD_TARGET
	default "u-boot.img" if BOARD_EN7512_REFERENCE

config BOARD_EN7512_REFERENCE
	bool "EN7512/EN7521 reference board"
	select BINMAN
	select SPL_LOADER_SUPPORT if SPL
	help
	  Build a boot image compatible with the EN7512/EN7521 TCBoot flow.
	  TPL initializes the serial flash controller, executes the legacy DDR
	  calibration stage from FE SRAM and loads SPL into DDR.

config BOARD_EN7512_XR500V_RAM
	bool "TP-Link Archer XR500v RAM-only chainload"
	help
	  Build only U-Boot proper for loading at 0x81000000 after the
	  proprietary Bootbase/BLDR has initialized DDR.  This target has no
	  TPL/SPL flash image and deliberately disables SPI, MTD and Ethernet
	  for the first console-only hardware validation.

config BOARD_EN7512_XR500V_RAM_ETH
	bool "TP-Link Archer XR500v RAM-only Ethernet chainload"
	select BOARD_LATE_INIT
	help
	  Build only U-Boot proper for loading at 0x81000000 after the
	  proprietary Bootbase/BLDR has initialized DDR.  This target adds the
	  EN751221 FE/QDMA and switch Ethernet path but deliberately keeps SPI,
	  MTD and all persistent environment support disabled.

endmenu
```

## configs/en751221_tplink_archer-xr500v-v1_defconfig
```kconfig
CONFIG_MIPS=y
CONFIG_SKIP_LOWLEVEL_INIT=y
CONFIG_NR_DRAM_BANKS=1
CONFIG_ENV_SIZE=0x1000
CONFIG_DM_GPIO=y
CONFIG_DEFAULT_DEVICE_TREE="econet,en751221-tplink_archer-xr500v-v1"
CONFIG_SYS_LOAD_ADDR=0x82000000
CONFIG_ARCH_ECONET=y
CONFIG_ECONET_BOOTROM_CHAINLOADER=y
CONFIG_SYS_MIPS_TIMER_FREQ=450000000
CONFIG_MIPS_CACHE_SETUP=y
CONFIG_MIPS_CACHE_DISABLE=y
CONFIG_MIPS_RELOCATION_TABLE_SIZE=0xc000
CONFIG_RESTORE_EXCEPTION_VECTOR_BASE=y
CONFIG_MIPS_BOOT_FDT=y
CONFIG_FIT=y
CONFIG_FIT_VERBOSE=y
CONFIG_BOOTDELAY=3
CONFIG_OF_STDOUT_VIA_ALIAS=y
CONFIG_DEFAULT_FDT_FILE="econet,en751221-tplink_archer-xr500v-v1.dtb"
CONFIG_SYS_PBSIZE=1049
CONFIG_SYS_CONSOLE_IS_IN_ENV=y
CONFIG_DISPLAY_CPUINFO=y
# CONFIG_DISPLAY_BOARDINFO is not set
CONFIG_HUSH_PARSER=y
CONFIG_SYS_PROMPT="U-Boot> "
CONFIG_SYS_MAXARGS=8
CONFIG_CMD_BOOTZ=y
CONFIG_CMD_BOOTMENU=y
# CONFIG_CMD_ELF is not set
# CONFIG_CMD_XIMG is not set
CONFIG_CMD_BIN2MAC=y
CONFIG_CMD_MEMINFO=y
CONFIG_CMD_BIND=y
CONFIG_CMD_GPIO=y
CONFIG_CMD_MTD=y
# CONFIG_CMD_SETEXPR is not set
CONFIG_CMD_DHCP=y
CONFIG_CMD_MII=y
CONFIG_CMD_PING=y
CONFIG_CMD_EXT4=y
CONFIG_CMD_FAT=y
CONFIG_CMD_FS_GENERIC=y
CONFIG_CMD_MTDPARTS=y
CONFIG_CMD_LOG=y
CONFIG_CMD_UBI=y
CONFIG_ENV_OVERWRITE=y
CONFIG_ENV_IS_IN_UBI=y
CONFIG_ENV_REDUNDANT=y
CONFIG_ENV_UBI_PART="ubi"
CONFIG_ENV_UBI_VOLUME="ubootenv"
CONFIG_ENV_UBI_VOLUME_REDUND="ubootenv2"
CONFIG_ENV_RELOC_GD_ENV_ADDR=y
CONFIG_ENV_USE_DEFAULT_ENV_TEXT_FILE=y
CONFIG_ENV_DEFAULT_ENV_TEXT_FILE="defenvs/en751221_tplink_archer-xr500v-v1"
CONFIG_ENV_VARS_UBOOT_RUNTIME_CONFIG=y
CONFIG_NET_RANDOM_ETHADDR=y
CONFIG_SYS_RX_ETH_BUFFER=16
CONFIG_BUTTON=y
CONFIG_BUTTON_GPIO=y
CONFIG_DMA=y
CONFIG_LED=y
CONFIG_LED_BOOT=y
CONFIG_LED_BLINK=y
CONFIG_LED_SW_BLINK=y
CONFIG_LED_GPIO=y
CONFIG_MTD=y
CONFIG_DM_MTD=y
CONFIG_MTD_SPI_NAND=y
CONFIG_UBI_BLOCK=y
CONFIG_PHY=y
CONFIG_RAM=y
CONFIG_SPI=y
CONFIG_DM_SPI=y
CONFIG_AIROHA_SNFI_SPI=y
# CONFIG_UBIFS_SILENCE_MSG is not set
CONFIG_SHA512=y
```

## configs/en7512_xr500v_ram_eth_defconfig
```kconfig
CONFIG_MIPS=y
CONFIG_SKIP_LOWLEVEL_INIT=y
CONFIG_SYS_MALLOC_LEN=0x100000
CONFIG_NR_DRAM_BANKS=1
CONFIG_ENV_SIZE=0x1000
CONFIG_DEFAULT_DEVICE_TREE="econet,en7512-xr500v-ram-eth"
CONFIG_SYS_LOAD_ADDR=0x82000000
CONFIG_SYS_MEM_TOP_HIDE=0x100000
CONFIG_ARCH_EN75XX=y
CONFIG_BOARD_EN7512_XR500V_RAM_ETH=y
CONFIG_SYS_MIPS_TIMER_FREQ=150000000
CONFIG_MIPS_CACHE_SETUP=y
CONFIG_MIPS_CACHE_DISABLE=y
CONFIG_RESTORE_EXCEPTION_VECTOR_BASE=y
CONFIG_MIPS_BOOT_FDT=y
CONFIG_BOOTDELAY=-1
CONFIG_OF_STDOUT_VIA_ALIAS=y
CONFIG_DISPLAY_CPUINFO=y
CONFIG_HUSH_PARSER=y
# CONFIG_CMD_SAVEENV is not set
CONFIG_CMD_MEMINFO=y
CONFIG_CMD_DM=y
# CONFIG_CMD_BOOTP is not set
CONFIG_CMD_PING=y
# CONFIG_CMD_TFTPBOOT is not set
CONFIG_ENV_RELOC_GD_ENV_ADDR=y
CONFIG_NET_RANDOM_ETHADDR=y
CONFIG_SYS_RX_ETH_BUFFER=16
CONFIG_AIROHA_ETH=y
```

## configs/en7528_reference_defconfig
```kconfig
CONFIG_MIPS=y
CONFIG_SYS_LITTLE_ENDIAN=y
CONFIG_SKIP_LOWLEVEL_INIT=y
CONFIG_SYS_MALLOC_LEN=0x400000
CONFIG_NR_DRAM_BANKS=1
CONFIG_ENV_SIZE=0x1000
CONFIG_DEFAULT_DEVICE_TREE="econet,en7528-reference"
CONFIG_SYS_LOAD_ADDR=0x82000000
CONFIG_SYS_BOOTM_LEN=0x08000000
CONFIG_ARCH_ECONET=y
CONFIG_TARGET_EN7528=y
CONFIG_SYS_MIPS_TIMER_FREQ=200000000
# CONFIG_MIPS_CACHE_SETUP is not set
CONFIG_RESTORE_EXCEPTION_VECTOR_BASE=y
CONFIG_MIPS_BOOT_FDT=y
CONFIG_FIT=y
CONFIG_FIT_VERBOSE=y
CONFIG_BOOTDELAY=3
CONFIG_OF_STDOUT_VIA_ALIAS=y
CONFIG_DEFAULT_FDT_FILE="econet,en7528-reference.dtb"
CONFIG_SYS_PBSIZE=1049
CONFIG_SYS_CONSOLE_IS_IN_ENV=y
CONFIG_DISPLAY_CPUINFO=y
# CONFIG_DISPLAY_BOARDINFO is not set
CONFIG_BOARD_LATE_INIT=y
CONFIG_HUSH_PARSER=y
CONFIG_SYS_PROMPT="EN7528 U-Boot> "
CONFIG_SYS_MAXARGS=16
CONFIG_CMD_BOOTZ=y
CONFIG_CMD_BOOTMENU=y
CONFIG_CMD_MEMINFO=y
CONFIG_CMD_BIND=y
CONFIG_CMD_MTD=y
CONFIG_CMD_SF=y
CONFIG_CMD_DHCP=y
CONFIG_CMD_MII=y
CONFIG_CMD_PING=y
CONFIG_CMD_TFTPBOOT=y
CONFIG_CMD_MTDPARTS=y
CONFIG_CMD_LOG=y
CONFIG_ENV_OVERWRITE=y
CONFIG_ENV_IS_NOWHERE=y
CONFIG_ENV_RELOC_GD_ENV_ADDR=y
CONFIG_ENV_VARS_UBOOT_RUNTIME_CONFIG=y
CONFIG_NET_RANDOM_ETHADDR=y
CONFIG_SYS_RX_ETH_BUFFER=16
CONFIG_REGMAP=y
CONFIG_CLK=y
CONFIG_DM_RESET=y
CONFIG_MTD=y
CONFIG_DM_MTD=y
CONFIG_DM_MDIO=y
CONFIG_AIROHA_ETH=y
CONFIG_HEXDUMP=y
CONFIG_PHY=y
CONFIG_PINCTRL=y
CONFIG_PINCTRL_AIROHA_EN7528=y
CONFIG_SYS_NS16550=y
CONFIG_SYS_NS16550_MEM32=y
CONFIG_DEBUG_UART=y
CONFIG_DEBUG_UART_NS16550=y
CONFIG_DEBUG_UART_BASE=0xbfbf0000
CONFIG_DEBUG_UART_CLOCK=1843200
CONFIG_DEBUG_UART_SHIFT=2
CONFIG_DEBUG_UART_SKIP_INIT=y
CONFIG_SPI=y
CONFIG_DM_SPI=y
CONFIG_AIROHA_SNFI_SPI=y
CONFIG_DM_SPI_FLASH=y
CONFIG_SPI_FLASH=y
CONFIG_MTD_SPI_NAND=y
CONFIG_SPI_FLASH_WINBOND=y
CONFIG_SPI_FLASH_XMC=y
CONFIG_SPI_FLASH_MTD=y
CONFIG_LZMA=y
CONFIG_ECONET_FLASH_BOOT=y
```

## configs/en7528_tplink_xc220_g3v_defconfig
```kconfig
CONFIG_MIPS=y
CONFIG_SKIP_LOWLEVEL_INIT=y
CONFIG_NR_DRAM_BANKS=1
CONFIG_ENV_SIZE=0x1000
CONFIG_DM_GPIO=y
CONFIG_DEFAULT_DEVICE_TREE="econet,en7528-tplink-xc220-g3v"
CONFIG_SYS_BOOTM_LEN=0x08000000
CONFIG_SYS_LOAD_ADDR=0x82000000
CONFIG_ARCH_ECONET=y
CONFIG_TARGET_EN7528=y
CONFIG_BUILD_TARGET="u-boot.bin"
CONFIG_SYS_MIPS_TIMER_FREQ=200000000
CONFIG_MIPS_RELOCATION_TABLE_SIZE=0xc000
CONFIG_RESTORE_EXCEPTION_VECTOR_BASE=y
CONFIG_MIPS_BOOT_FDT=y
CONFIG_FIT=y
CONFIG_FIT_VERBOSE=y
CONFIG_BOOTSTD=y
# CONFIG_BOOTMETH_VBE is not set
CONFIG_BOOTDELAY=3
CONFIG_OF_STDOUT_VIA_ALIAS=y
CONFIG_DEFAULT_FDT_FILE="econet,en7528-tplink-xc220-g3v.dtb"
CONFIG_SYS_PBSIZE=1049
CONFIG_SYS_CONSOLE_IS_IN_ENV=y
CONFIG_DISPLAY_CPUINFO=y
# CONFIG_DISPLAY_BOARDINFO is not set
CONFIG_HUSH_PARSER=y
CONFIG_SYS_PROMPT="U-Boot> "
CONFIG_SYS_MAXARGS=16
CONFIG_CMD_BOOTZ=y
CONFIG_CMD_BOOTMENU=y
CONFIG_CMD_MEMINFO=y
CONFIG_CMD_BIND=y
CONFIG_CMD_GPIO=y
CONFIG_CMD_MTD=y
CONFIG_CMD_DHCP=y
CONFIG_CMD_MII=y
CONFIG_CMD_PING=y
CONFIG_CMD_MTDPARTS=y
CONFIG_CMD_LOG=y
CONFIG_ENV_OVERWRITE=y
CONFIG_ENV_RELOC_GD_ENV_ADDR=y
CONFIG_ENV_USE_DEFAULT_ENV_TEXT_FILE=y
CONFIG_ENV_DEFAULT_ENV_TEXT_FILE="defenvs/en7528_xc220_g3v_env"
CONFIG_ENV_VARS_UBOOT_RUNTIME_CONFIG=y
CONFIG_NET_RANDOM_ETHADDR=y
CONFIG_SYS_RX_ETH_BUFFER=16
CONFIG_BUTTON=y
CONFIG_BUTTON_GPIO=y
CONFIG_DMA=y
CONFIG_LED=y
CONFIG_LED_BOOT=y
CONFIG_LED_BLINK=y
CONFIG_LED_SW_BLINK=y
CONFIG_LED_GPIO=y
CONFIG_MTD=y
CONFIG_DM_MTD=y
CONFIG_DM_SPI_FLASH=y
CONFIG_SPI_FLASH_WINBOND=y
CONFIG_SPI_FLASH_XMC=y
CONFIG_SPI_FLASH_MTD=y
CONFIG_PHY=y
CONFIG_SYS_NS16550=y
CONFIG_SYS_NS16550_MEM32=y
CONFIG_SPI=y
CONFIG_DM_SPI=y
CONFIG_AIROHA_SNFI_SPI=y
CONFIG_LZMA=y
CONFIG_LZO=y
CONFIG_HEXDUMP=y
```

## configs/en7580_xgz030_defconfig
```kconfig
CONFIG_MIPS=y
CONFIG_SYS_LITTLE_ENDIAN=y
CONFIG_SKIP_LOWLEVEL_INIT=y
CONFIG_SYS_MALLOC_LEN=0x400000
CONFIG_NR_DRAM_BANKS=1
CONFIG_ENV_SIZE=0x1000
CONFIG_DEFAULT_DEVICE_TREE="econet,en7580-xgz030"
CONFIG_SYS_LOAD_ADDR=0x82000000
CONFIG_SYS_BOOTM_LEN=0x10000000
CONFIG_ARCH_ECONET=y
CONFIG_TARGET_EN7580=y
CONFIG_SYS_MIPS_TIMER_FREQ=650000000
# CONFIG_MIPS_CACHE_SETUP is not set
CONFIG_RESTORE_EXCEPTION_VECTOR_BASE=y
CONFIG_MIPS_BOOT_FDT=y
CONFIG_FIT=y
CONFIG_FIT_VERBOSE=y
CONFIG_BOOTDELAY=3
CONFIG_OF_STDOUT_VIA_ALIAS=y
CONFIG_DEFAULT_FDT_FILE="econet,en7580-xgz030.dtb"
CONFIG_SYS_PBSIZE=1049
CONFIG_SYS_CONSOLE_IS_IN_ENV=y
CONFIG_DISPLAY_CPUINFO=y
# CONFIG_DISPLAY_BOARDINFO is not set
CONFIG_HUSH_PARSER=y
CONFIG_SYS_PROMPT="EN7580 U-Boot> "
CONFIG_SYS_MAXARGS=16
CONFIG_CMD_BOOTZ=y
CONFIG_CMD_BOOTMENU=y
CONFIG_CMD_MEMINFO=y
CONFIG_CMD_BIND=y
CONFIG_CMD_MTD=y
CONFIG_CMD_SF=y
CONFIG_CMD_LOG=y
CONFIG_ENV_OVERWRITE=y
CONFIG_ENV_IS_NOWHERE=y
CONFIG_ENV_RELOC_GD_ENV_ADDR=y
CONFIG_ENV_VARS_UBOOT_RUNTIME_CONFIG=y
CONFIG_CLK=y
CONFIG_MTD=y
CONFIG_DM_MTD=y
CONFIG_MTD_SPI_NAND=y
CONFIG_PHY=y
CONFIG_RAM=y
CONFIG_SPI=y
CONFIG_DM_SPI=y
CONFIG_AIROHA_SNFI_SPI=y
CONFIG_SYS_NS16550=y
CONFIG_SYS_NS16550_MEM32=y
CONFIG_DEBUG_UART=y
CONFIG_DEBUG_UART_NS16550=y
CONFIG_DEBUG_UART_BASE=0xbfbf0000
CONFIG_DEBUG_UART_CLOCK=1843200
CONFIG_DEBUG_UART_SHIFT=2
CONFIG_DEBUG_UART_SKIP_INIT=y
CONFIG_LZMA=y
```

## drivers/pinctrl/airoha/Kconfig
```kconfig
# SPDX-License-Identifier: GPL-2.0-only

config PINCTRL_AIROHA
	depends on ARCH_AIROHA || ARCH_ECONET
	select PINCTRL_FULL
	select PINCTRL_GENERIC
	select PINMUX
	select PINCONF
	select REGMAP
	select SYSCON
	bool

config PINCTRL_AIROHA_EN751221
	bool "EcoNet EN751221 pin controller and gpio driver"
	depends on TARGET_EN751221
	select PINCTRL_AIROHA
	help
	  Enable pin multiplexing, pin configuration and GPIO support for
	  EcoNet EN751221 family SoCs.

config PINCTRL_AIROHA_EN7528
	bool "EcoNet EN7528 pin controller and gpio driver"
	depends on TARGET_EN7528
	select PINCTRL_AIROHA
	help
	  Enable pin multiplexing, pin configuration and GPIO support for
	  EcoNet EN7528 family SoCs.

config PINCTRL_AIROHA_EN7523
	bool "Airoha EN7523 pin controller and gpio driver"
	depends on TARGET_EN7523
	select PINCTRL_AIROHA

config PINCTRL_AIROHA_AN7581
	bool "Airoha AN7581 pin controller and gpio driver"
	depends on TARGET_AN7581
	select PINCTRL_AIROHA

config PINCTRL_AIROHA_AN7583
	bool "Airoha AN7583 pin controller and gpio driver"
	depends on TARGET_AN7583
	select PINCTRL_AIROHA
```
